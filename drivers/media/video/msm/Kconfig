## drivers/media/video/msm/Kconfig
```kconfig
comment "Camera Sensor Selection"
config MT9T013
	bool "Sensor mt9t013 (BAYER 3M)"
	depends on MSM_CAMERA
	default n
	---help---
	  MICRON 3M Bayer Sensor with AutoFocus

config MT9D112
	bool "Sensor mt9d112 (YUV 2M)"
	depends on MSM_CAMERA
	default n
	---help---
	  MICRON 2M YUV Sensor
config VX6953
	bool "Sensor VX6953 (BAYER 5M)"
	depends on MSM_CAMERA && ARCH_MSM7X30
	default y
	---help---
	STM 5M Bayer Sensor with EDOF

config MT9P012
	bool "Sensor mt9p012 (BAYER 5M)"
	depends on MSM_CAMERA
	default n
	---help---
	  MICRON 5M Bayer Sensor with Autofocus
	  
config MT9V113
	bool "Sensor mt9v113 (YUV 0.3M)"
	depends on MSM_CAMERA
	default n
	---help---
	  APTINA 0.3M YUV Sensor
 
config MT9T11X
	bool "Sensor mt9t111 or mt9t112 (YUV 3.1M)"
	depends on MSM_CAMERA
	default y
	---help---
	  APTINA 3.1M YUV Sensor
	  
if MT9T11X
config MT9T11X_QTECH_MCNEX_FPC
	bool "Sensor mt9t111 or mt9t112 (YUV 3.1M)"
	depends on MSM_CAMERA
	depends on MACH_BLADE || MACH_SMOOTH || MACH_RAISE
	default y
	---help---
	  APTINA 3.1M YUV Sensor

config MT9T11X_QTECH_MCNEX_SOCKET
	bool "Sensor mt9t111 or mt9t112 (YUV 3.1M)"
	depends on MSM_CAMERA
	depends on MACH_MOONCAKE || MACH_JOE || MACH_R750 || MACH_AMIGO
	default y
	---help---
	  APTINA 3.1M YUV Sensor
endif # MT9T11X
	  
choice
	prompt "AF module"
	depends on MT9P012
	default MSM_CAMERA_AF_FOXCONN

config MSM_CAMERA_AF_FOXCONN
	bool "FOXCONN Module"
	help
	  This driver supports FOXCONN AF module for 5M Bayer sensor

config MSM_CAMERA_AF_BAM
	bool "BAM Module"
	help
	  This driver supports BAM AF module for 5M Bayer sensor

endchoice

config MT9P012_KM
	bool "Sensor mt9p012 KM module (BAYER 5M)"
	depends on MSM_CAMERA
	default n
	---help---
	  MICRON 5M Bayer Sensor KM modules with Autofocus

config S5K3E2FX
	bool "Sensor s5k3e2fx (Samsung 5M)"
	depends on MSM_CAMERA
	default n
	---help---
	  Samsung 5M with Autofocus

config VB6801
	bool "Sensor vb6801"
	depends on MSM_CAMERA
	---help---
	  5M with flash
	  
config SENSOR_ADAPTER
	bool "Adapter for different sensors"
	depends on MSM_CAMERA
	default n
	---help---
	  Adapter

config MSM_CAMERA_FLASH
	bool "Qualcomm MSM camera flash support"
	depends on MSM_CAMERA
	default n
	---help---
	  Enable support for LED flash for msm camera

config MSM_GEMINI
	tristate "Qualcomm MSM Gemini Jpeg Engine support"
	depends on MSM_CAMERA
	default M
	---help---
	  Enable support for Gemini Jpeg Engine
```
